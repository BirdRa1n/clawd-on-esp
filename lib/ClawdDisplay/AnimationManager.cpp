#include "AnimationManager.h"
#include <FS.h>
#include <LittleFS.h>
using fs::File;

// CRLI format (custom, generated by scratchpad/pipeline_idx.py):
//   'C','R', ver=2, palColors u8, width u16, height u16, frameCount u16, maxRunCount u16
//   palette: palColors x u16 (RGB565 LE)
//   frames (sequential): { delayMs u16, runCount u16, runCount x {count u8, index u8} }
// Decoded straight from LittleFS (streaming) -> tiny RAM (run buffer ~5 KB).

static const int ANIM_H = 238;   // status bar lives below this

static File      cf;             // current animation file (kept open)
static TFT_eSPI *gTft = nullptr;
static uint16_t  palette[256];
static uint16_t  lineBuf[256];   // one screen row (>= max width 240)
static uint8_t  *runbuf = nullptr;
static size_t    runbufCap = 0;
static int       fW = 0, fH = 0, fFrames = 0, fPalN = 0, fMaxRuns = 0;
static uint32_t  fDataStart = 0;
static int       fFrameIdx = 0;
static int       gXoff = 0, gYoff = 0;

static bool readFully(File &f, uint8_t *b, size_t n) {
  size_t got = 0;
  while (got < n) {
    int r = f.read(b + got, n - got);
    if (r <= 0) return false;
    got += r;
  }
  return true;
}
static inline uint16_t u16(const uint8_t *p) { return p[0] | (p[1] << 8); }

static const char *pathFor(ClawdState s) {
  switch (s) {
    case ClawdState::Thinking:     return "/thinking.crli";
    case ClawdState::Working:      return "/working.crli";
    case ClawdState::Juggling:     return "/juggling.crli";
    case ClawdState::Carrying:     return "/carrying.crli";
    case ClawdState::Sweeping:     return "/sweeping.crli";
    case ClawdState::Attention:    return "/attention.crli";
    case ClawdState::Notification: return "/notification.crli";
    case ClawdState::Error:        return "/error.crli";
    case ClawdState::Sleeping:     return "/sleeping.crli";
    default:                       return "/idle.crli";
  }
}

bool AnimationManager::begin(TFT_eSPI *tft) {
  _tft = tft;
  gTft = tft;
  tft->setSwapBytes(true);   // our palette is RGB565 LE; TFT wants byte-swapped on the wire
  if (!LittleFS.begin(false)) {
    Serial.println("[anim] LittleFS mount failed (run 'uploadfs'?)");
    _assetsOk = false;
  } else {
    _assetsOk = LittleFS.exists("/idle.crli");
    Serial.printf("[anim] LittleFS ok, assets %s\n", _assetsOk ? "present" : "MISSING");
  }
  return _assetsOk;
}

bool AnimationManager::openState(ClawdState s) {
  if (_open) { cf.close(); _open = false; }
  const char *path = pathFor(s);
  cf = LittleFS.open(path, "r");
  if (!cf) { Serial.printf("[anim] open failed: %s\n", path); return false; }

  uint8_t hdr[12];
  if (!readFully(cf, hdr, 12) || hdr[0] != 'C' || hdr[1] != 'R' || hdr[2] != 2) {
    Serial.printf("[anim] bad header: %s\n", path); cf.close(); return false;
  }
  fPalN    = hdr[3];
  fW       = u16(hdr + 4);
  fH       = u16(hdr + 6);
  fFrames  = u16(hdr + 8);
  fMaxRuns = u16(hdr + 10);

  for (int i = 0; i < fPalN; i++) { uint8_t b[2]; readFully(cf, b, 2); palette[i] = u16(b); }
  fDataStart = 12 + fPalN * 2;

  size_t need = (size_t)fMaxRuns * 2;
  if (need > runbufCap) {
    free(runbuf);
    runbuf = (uint8_t *)malloc(need);
    runbufCap = runbuf ? need : 0;
    if (!runbuf) { Serial.println("[anim] runbuf alloc failed"); cf.close(); return false; }
  }

  gXoff = (_tft->width() - fW) / 2; if (gXoff < 0) gXoff = 0;
  gYoff = (ANIM_H - fH) / 2;         if (gYoff < 0) gYoff = 0;
  fFrameIdx = 0;
  _open = true;
  Serial.printf("[anim] %s: %dx%d %df pal%d maxRuns%d\n", path, fW, fH, fFrames, fPalN, fMaxRuns);
  return true;
}

// Reads + renders the current frame; returns its delay in ms.
static int playFrame() {
  uint8_t fh[4];
  if (!readFully(cf, fh, 4)) { cf.seek(fDataStart); fFrameIdx = 0; if (!readFully(cf, fh, 4)) return 100; }
  int delayMs  = u16(fh);
  int runCount = u16(fh + 2);
  size_t rbytes = (size_t)runCount * 2;
  if (rbytes > runbufCap || !readFully(cf, runbuf, rbytes)) return delayMs > 0 ? delayMs : 100;

  int col = 0, row = 0;
  for (int i = 0; i < runCount; i++) {
    uint8_t cnt = runbuf[i * 2];
    uint16_t color = palette[runbuf[i * 2 + 1]];
    while (cnt--) {
      lineBuf[col++] = color;
      if (col >= fW) {
        gTft->pushImage(gXoff, gYoff + row, fW, 1, lineBuf);
        col = 0;
        if (++row >= fH) break;
      }
    }
  }

  if (++fFrameIdx >= fFrames) { fFrameIdx = 0; cf.seek(fDataStart); }
  return delayMs;
}

void AnimationManager::setState(ClawdState s) {
  if (s == _current && (_open || !_assetsOk)) return;
  _current = s;
  if (_assetsOk && openState(s)) {
    _nextFrameAt = millis();
  } else {
    _open = false;
    drawFallback(s);
  }
}

void AnimationManager::loop() {
  if (!_open) return;
  if ((int32_t)(millis() - _nextFrameAt) < 0) return;
  int d = playFrame();
  if (d < 10) d = 10;
  _nextFrameAt = millis() + d;
}

void AnimationManager::drawFallback(ClawdState s) {
  _tft->fillRect(0, 0, _tft->width(), ANIM_H, clawdColor(s));
  _tft->setTextDatum(MC_DATUM);
  _tft->setTextColor(s == ClawdState::Sleeping ? TFT_BLACK : TFT_WHITE);
  _tft->drawString(clawdName(s), _tft->width() / 2, ANIM_H / 2, 4);
}
